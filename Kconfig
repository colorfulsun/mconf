## Kconfig
```kconfig
menu "General setup"

config MODULES
	def_bool y
	option modules

config TEST 
    tristate "test"
    default m

config BROKEN
	bool
	help
	  This option cannot be enabled. It is used as dependency
	  for broken and incomplete features.

config DEPRECATED
	bool
	help
	  This option cannot be enabled.  It it used as a dependency for
	  code that relies on deprecated features that will be removed and
	  the conversion deadline has passed.
endmenu
```
